## firmware/ble-beacon/sdkconfig.defaults
```kconfig
# Arduino Nano ESP32 has 16 MB flash; the key partition lives at 0x110000.
CONFIG_ESPTOOLPY_FLASHSIZE_16MB=y
CONFIG_ESPTOOLPY_FLASHSIZE="16MB"

# Custom partition table with a dedicated "key" partition (factory app + nvs_keys).
CONFIG_PARTITION_TABLE_CUSTOM=y
CONFIG_PARTITION_TABLE_CUSTOM_FILENAME="partitions.csv"

# Bluetooth: BLE-only via Bluedroid (ESP32-S3 has no classic BT).
CONFIG_BT_ENABLED=y
CONFIG_BT_BLUEDROID_ENABLED=y
CONFIG_BT_BLE_ENABLED=y
# Use legacy (BLE 4.2) advertising APIs (esp_ble_gap_*_advertising / config_adv_data_raw).
# On BLE 5.0 chips like the ESP32-S3 these are off by default in favour of extended adv.
CONFIG_BT_BLE_42_FEATURES_SUPPORTED=y

# Console over the Nano ESP32 native USB (USB-Serial/JTAG).
CONFIG_ESP_CONSOLE_USB_SERIAL_JTAG=y
```

## firmware/hello-world/sdkconfig.defaults
```kconfig
# Defaults applied on first `idf.py set-target esp32s3`.
# The Arduino Nano ESP32 exposes its console over the ESP32-S3 native USB
# (USB-Serial/JTAG peripheral), so route stdio there — no extra UART wiring,
# and `idf.py monitor` works over the same USB cable used to flash.
CONFIG_ESP_CONSOLE_USB_SERIAL_JTAG=y
```
